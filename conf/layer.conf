## conf/layer.conf
```bitbake
# We have a conf and classes directory, add to BBPATH
BBPATH .= ":${LAYERDIR}"

# We have recipes-* directories, add to BBFILES
BBFILES += "${LAYERDIR}/recipes-*/*/*.bb \
            ${LAYERDIR}/recipes-*/*/*.bbappend"

BBFILE_COLLECTIONS += "../layers/meta-explore"
BBFILE_PATTERN_../layers/meta-explore = "^${LAYERDIR}/"
BBFILE_PRIORITY_../layers/meta-explore = "6"
```
